OUTPUT_FORMAT(elf64-x86-64)

SECTIONS
{
    . = @F_FATLOADER_MEMORY_LOCATION@;

    .intro :
    {
        *(.intro)
    }

    .rm_data :
    {
        *(.rm_data)
    }

    __rm_data_top = .;

    ASSERT ((__rm_data_top < 0xFFFF), "Error: rm_data section too big")

    .text :
    {
        *(.text*)
    }

    . = ALIGN(0x200);

    .rodata :
    {
        *(.rodata*)
    }

    . = ALIGN(0x200);

    .data :
    {
        *(.data*)
    }

    . = ALIGN(0x200);

    .bss :
    {
        *(.bss*)
    }

    . = @F_FATLOADER_MEMORY_LOCATION@ + @F_FATLOADER_SIZE_IN_SECTORS@ * 0x200 - 4;

    .magic :
    {
        LONG(@F_FATLOADER_MAGIC@);
    }
}