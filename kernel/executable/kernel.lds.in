OUTPUT_FORMAT(elf64-x86-64)

ENTRY(fkrnl_entry)

SECTIONS
{
    . = @F_KERNEL_VIRTUAL_ADDRESS@;

    .kernel_stack (NOLOAD) :
    {
        . = . + @F_KERNEL_STACK_SIZE_KB@ * 1024;
        KERNEL_STACK_TOP = .;
    }

    .text : ALIGN(0x1000)
    {
        *(.intro)
        *(.text*)
    }

    .rodata : ALIGN(0x1000)
    {
        *(.rodata*)
    }

    .data : ALIGN(0x1000)
    {
        *(.data*)
    }

    .bss : ALIGN(0x1000)
    {
        *(.bss*)
        *(COMMON)
    }

    .eh_frame : ALIGN(0x1000)
    {
        *(.eh_frame)
    }

    . = ALIGN(0x1000);
}